## main/Kconfig.projbuild
```kconfig
menu "Hidroponik WiFi Configuration"

    config WIFI_STA_SSID
        string "SSID WiFi rumah (STA)"
        default ""
        help
            SSID WiFi yang mau dikonek pas boot. WiFi jalan mode APSTA: AP hotspot
            selalu aktif dari awal, STA nyoba connect ke SSID ini dan tetap retry
            terus-menerus di background kalau gagal/putus (nggak exclusive sama AP).

    config WIFI_STA_PASSWORD
        string "Password WiFi rumah (STA)"
        default ""

    config WIFI_STA_CONNECT_TIMEOUT_SEC
        int "Timeout tunggu STA connect pas boot (detik)"
        default 10
        range 5 120
        help
            Cuma dipakai buat satu hal: berapa lama app_main() nunggu di boot
            sebelum lanjut init komponen lain (dan buat nentuin log/return value
            "STA berhasil connect pas boot" atau belum). STA sendiri nggak pernah
            berhenti retry connect di background sama sekali -- kalau gagal/putus,
            tetap terus dicoba lagi tiap beberapa detik selamanya (lihat
            STA_RECONNECT_DELAY_MS di wifi_manager.c), nggak terpengaruh timeout ini.

    config WIFI_AP_SSID
        string "SSID AP (hotspot lokal, aktif terus)"
        default "Hidroponik-AP"

    config WIFI_AP_PASSWORD
        string "Password AP (kosongkan buat AP open, min 8 char kalau diisi)"
        default "hidroponik123"

    config WIFI_AP_CHANNEL
        int "Channel AP"
        range 1 13
        default 6

    config WIFI_AP_MAX_STA_CONN
        int "Maksimal koneksi ke fallback AP"
        default 4
        range 1 15

    config WIFI_SNTP_SERVER
        string "SNTP server (sync waktu pas STA mode, buat timestamp histori Firebase)"
        default "pool.ntp.org"

endmenu

menu "MQTT (HiveMQ Cloud)"

    config MQTT_BROKER_HOST
        string "Broker hostname"
        default ""
        help
            Hostname cluster HiveMQ Cloud, misal xxxxxxxx.s1.eu.hivemq.cloud

    config MQTT_BROKER_PORT
        int "Broker port (TLS)"
        default 8883

    config MQTT_USERNAME
        string "MQTT username"
        default ""

    config MQTT_PASSWORD
        string "MQTT password"
        default ""

    config MQTT_TOPIC
        string "Topic publish data sensor"
        default "hidroponik/sensor"

endmenu

menu "Firebase Realtime Database"

    config FIREBASE_DATABASE_HOST
        string "Database host (tanpa https://, misal xxx-default-rtdb.asia-southeast1.firebasedatabase.app)"
        default ""

    config FIREBASE_PATH_PREFIX
        string "Path prefix node data sensor di RTDB"
        default "sensors"

endmenu

menu "Sensor Configuration"

    config SENSOR_DS18B20_GPIO
        int "GPIO DS18B20 (suhu air, 1-Wire)"
        default 4

    config SENSOR_DHT22_GPIO
        int "GPIO DHT22 (suhu & kelembaban udara)"
        default 5

    config SENSOR_ULTRASONIC_TRIG_GPIO
        int "GPIO TRIG HC-SR04 (level air)"
        default 32

    config SENSOR_ULTRASONIC_ECHO_GPIO
        int "GPIO ECHO HC-SR04 (level air)"
        default 33
        help
            Echo HC-SR04 keluar 5V, WAJIB lewat voltage divider (R4 1k + R5 2k)
            sebelum masuk pin ini karena ESP32 cuma toleran 3.3V.

    config WATER_TANK_EMPTY_DISTANCE_CM
        int "Jarak sensor ke permukaan air pas tangki KOSONG (cm, WAJIB dikalibrasi fisik)"
        default 40

    config WATER_TANK_FULL_DISTANCE_CM
        int "Jarak sensor ke permukaan air pas tangki PENUH (cm, WAJIB dikalibrasi fisik)"
        default 5

    config SENSOR_READ_INTERVAL_SEC
        int "Interval baca semua sensor (detik)"
        default 10
        range 2 3600

    config FIREBASE_PUSH_INTERVAL_READS
        int "Push ke Firebase tiap N kali baca sensor (biar nggak spam request)"
        default 6
        range 1 360

    config PH_NEUTRAL_MV
        int "Tegangan pH netral dalam mV (WAJIB dikalibrasi pakai buffer solution pH 7)"
        default 2500

    config PH_MV_PER_PH
        int "Slope tegangan per unit pH dalam mV/pH (WAJIB dikalibrasi pakai buffer pH 4 & 10)"
        default 180

endmenu
```
